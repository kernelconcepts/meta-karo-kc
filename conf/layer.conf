## conf/machine/txul-5011.conf
```bitbake
#@TYPE: Machine
#@NAME: Ka-Ro electronics TX6UL eMMC
#@SOC: i.MX6UL
#@DESCRIPTION: Machine configuration for Ka-Ro electronics TX6UL (i.MX6UL) Computer-On-Module with eMMC
#@MAINTAINER: Oliver Wendt <ow@karo-electronics.com>

KERNEL_DEVICETREE ?= "imx6ul-tx6ul-0011.dtb"

UBOOT_MACHINE ?= "tx6ul-0011_config"

require imx6ul-txul-emmc.conf
```
