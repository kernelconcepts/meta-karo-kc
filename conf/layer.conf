## conf/layer.conf
```bitbake
# We have a conf and classes directory, add to BBPATH
BBPATH .= ":${LAYERDIR}"

# We have a packages directory, add to BBFILES
BBFILES += "${LAYERDIR}/recipes-*/*/*.bb \
            ${LAYERDIR}/recipes-*/*/*.bbappend"

BBFILE_COLLECTIONS += "karo-kc"
BBFILE_PATTERN_karo-kc := "^${LAYERDIR}/"
BBFILE_PRIORITY_karo-kc = "10"

LAYERDEPENDS_karo-kc = "core networking-layer meta-python"

LAYERSERIES_COMPAT_karo-kc = "gatesgarth"
```

## conf/machine/aclavis-lvds-8137.conf
```bitbake
#@TYPE: Machine
#@NAME: Glyn Aclavis Board (10" lvds display) with TX6Q-8137
#@SOC: i.MX6QP
#@DESCRIPTION: Machine configuration for Glyn Aclavis with 10"LVDS Display
#@MAINTAINER: Ole Reinhardt <ole.reinhardt@kernelconcepts.de>

KERNEL_DEVICETREE = "imx6qp-tx6-emmc-aclavis-lvds.dtb"

UBOOT_MACHINE ?= "tx6u-8133_config"

PREFERRED_PROVIDER_virtual/kernel ?= "linux-karo"
PREFERRED_VERSION_linux-karo = "4.9.123"

MACHINE_FEATURES_append = " wifi bluetooth touchscreen usbhost usbgadget screen alsa kms drm opengl libs eglfs egl evdev mtdev gbm dri vulkan gles gles2 egl osmesa imx etnaviv gbm "

TXBASE = "aclavis"

require tx6q-8137.conf
```

## conf/machine/include/imx-base.inc
```bitbake
# Provides the i.MX common settings
# Based on imx-base.inc from meta-freescale
# Reduced to minimum requirements to make use of the NXP BSP

# Set specific make target and binary suffix

PREFERRED_PROVIDER_virtual/xserver ??= "xserver-xorg"
XSERVER_DRIVER ??= "xf86-video-fbdev"
XSERVER_DRIVER_imxgpu2d ??= "xf86-video-imx-vivante"
XSERVER_DRIVER_vf ??= "xf86-video-modesetting"
XSERVER_DRIVER_use-mainline-bsp ??= "xf86-video-armada"
XSERVER ??= "xserver-xorg \
           xf86-input-evdev \
           ${XSERVER_DRIVER}"

INHERIT += "machine-overrides-extender"

MACHINEOVERRIDES_EXTENDER_mx25   = "use-mainline-bsp"
MACHINEOVERRIDES_EXTENDER_mx6q   = "imxfbdev:imxipu:imxvpu:imxgpu:imxgpu2d:imxgpu3d"
MACHINEOVERRIDES_EXTENDER_mx6dl  = "imxfbdev:imxpxp:imxipu:imxvpu:imxgpu:imxgpu2d:imxgpu3d:imxepdc"
MACHINEOVERRIDES_EXTENDER_mx6sx  = "imxfbdev:imxpxp:imxgpu:imxgpu2d:imxgpu3d"
MACHINEOVERRIDES_EXTENDER_mx6sl  = "imxfbdev:imxpxp:imxgpu:imxgpu2d:imxepdc"
MACHINEOVERRIDES_EXTENDER_mx6sll = "imxfbdev:imxpxp:imxepdc"
MACHINEOVERRIDES_EXTENDER_mx6ul  = "imxfbdev:imxpxp"
MACHINEOVERRIDES_EXTENDER_mx6ull = "imxfbdev:imxpxp:imxepdc"
MACHINEOVERRIDES_EXTENDER_mx7d   = "imxfbdev:imxpxp:imxepdc"
MACHINEOVERRIDES_EXTENDER_mx7ulp = "imxfbdev:imxpxp:imxgpu:imxgpu2d:imxgpu3d"
MACHINEOVERRIDES_EXTENDER_mx8qm  = "imxdrm:imxdpu:imxgpu:imxgpu2d:imxgpu3d"
MACHINEOVERRIDES_EXTENDER_mx8mm  = "imxdrm:imxvpu:imxgpu:imxgpu2d:imxgpu3d"
MACHINEOVERRIDES_EXTENDER_mx8mq  = "imxdrm:imxvpu:imxgpu:imxgpu3d"
MACHINEOVERRIDES_EXTENDER_mx8qxp = "imxdrm:imxdpu:imxgpu:imxgpu2d:imxgpu3d"

MACHINEOVERRIDES_EXTENDER_FILTER_OUT_use-mainline-bsp = " \
    mx6 \
    mx6q \
    mx6dl \
    mx6sx \
    mx6sl \
    mx6sll \
    mx6ul \
    mx6ull \
    \
    mx7 \
    mx7d \
    mx7ulp \
    \
    mx8 \
    mx8qm \
    mx8mm \
    mx8mq \
    mx8qxp \
"

# Sub-architecture support
MACHINE_SOCARCH_SUFFIX ?= ""
MACHINE_SOCARCH_SUFFIX_mx23 = "-mxs"
MACHINE_SOCARCH_SUFFIX_mx28 = "-mxs"
MACHINE_SOCARCH_SUFFIX_mx51 = "-mx5"
MACHINE_SOCARCH_SUFFIX_mx53 = "-mx5"
MACHINE_SOCARCH_SUFFIX_mx6q = "-mx6qdl"
MACHINE_SOCARCH_SUFFIX_mx6dl = "-mx6qdl"
MACHINE_SOCARCH_SUFFIX_mx6sx = "-mx6sx"
MACHINE_SOCARCH_SUFFIX_mx6sl = "-mx6sl"
MACHINE_SOCARCH_SUFFIX_mx6sll= "-mx6sll"
MACHINE_SOCARCH_SUFFIX_mx7d = "-mx7d"
MACHINE_SOCARCH_SUFFIX_mx7ulp = "-mx7ulp"
MACHINE_SOCARCH_SUFFIX_vf60 = "-vf60"
MACHINE_SOCARCH_SUFFIX_vf50 = "-vf50"
MACHINE_SOCARCH_SUFFIX_mx6ul  = "-mx6ul"
MACHINE_SOCARCH_SUFFIX_mx6ull = "-mx6ul"
MACHINE_SOCARCH_SUFFIX_mx8qm  = "-mx8"
MACHINE_SOCARCH_SUFFIX_mx8mm  = "-mx8mm"
MACHINE_SOCARCH_SUFFIX_mx8mq  = "-mx8m"
MACHINE_SOCARCH_SUFFIX_mx8qxp = "-mx8"
MACHINE_SOCARCH_SUFFIX_use-mainline-bsp = "-imx"

MACHINE_ARCH_FILTER = "virtual/kernel"
MACHINE_SOCARCH_FILTER_append_imx = " \
    alsa-lib \
    weston \
"
MACHINE_SOCARCH_FILTER_append_imxvpu = " \
    imx-codec \
    imx-parser \
    imx-vpuwrap \
    libimxvpuapi \
    virtual/imxvpu \
"
MACHINE_SOCARCH_FILTER_append_imxgpu = " \
    virtual/egl \
    virtual/mesa \
    virtual/libopenvg \
    libdrm \
    cairo \
    gstreamer1.0-plugins-bad \
    libgal-imx \
    pango \
"
MACHINE_SOCARCH_FILTER_append_imxgpu2d = " \
    virtual/libg2d \
"
MACHINE_SOCARCH_FILTER_append_imxgpu3d = " \
    virtual/libgl \
    virtual/libgles1 \
    virtual/libgles2 \
"
MACHINE_SOCARCH_FILTER_append_use-mainline-bsp = " \
    virtual/egl \
    virtual/libopenvg \
    virtual/libg2d \
    virtual/libgl \
    virtual/libgles1 \
    virtual/libgles2 \
    virtual/mesa \
    cairo \
    pango \
    qtbase \
"
MACHINE_SOCARCH_FILTER_append_mx6q = " \
    virtual/opencl-icd \
    opencl-headers \
"
MACHINE_SOCARCH_FILTER_append_mx8 = " \
    virtual/opencl-icd \
    opencl-headers \
"
MACHINE_SOCARCH_FILTER_append_mx8qm = " \
    virtual/libopenvx \
"

INHERIT += "fsl-dynamic-packagearch"

SIGGEN_EXCLUDE_SAFE_RECIPE_DEPS_append = " \
    imx-gpu-viv->kernel-module-imx-gpu-viv \
    libimxvpuapi->virtual/imxvpu \
    imx-vpuwrap->virtual/imxvpu \
    imx-codec->virtual/imxvpu \
    imx-test->virtual/imxvpu \
"

# Firmware
MACHINE_FIRMWARE ?= ""
MACHINE_FIRMWARE_append_mx25 = " firmware-imx-sdma-imx25"
MACHINE_FIRMWARE_append_mx7d = " linux-firmware-imx-sdma-imx7d firmware-imx-epdc"
MACHINE_FIRMWARE_append_mx6 = " linux-firmware-imx-sdma-imx6q"
MACHINE_FIRMWARE_append_mx6q = " firmware-imx-vpu-imx6q"
MACHINE_FIRMWARE_append_mx6dl = " firmware-imx-vpu-imx6d firmware-imx-epdc"
MACHINE_FIRMWARE_append_mx6sl = " firmware-imx-epdc"
MACHINE_FIRMWARE_append_mx6sll = " firmware-imx-epdc"
MACHINE_FIRMWARE_append_mx6ull = " firmware-imx-epdc"
MACHINE_FIRMWARE_append_mx53 = " firmware-imx-vpu-imx53 firmware-imx-sdma-imx53"
MACHINE_FIRMWARE_append_mx51 = " firmware-imx-vpu-imx51 firmware-imx-sdma-imx51"
MACHINE_FIRMWARE_append_mx8qxp = " firmware-imx-vpu-imx8qxp"
MACHINE_FIRMWARE_append_use-mainline-bsp = " linux-firmware-imx-sdma-imx6q linux-firmware-imx-sdma-imx7d firmware-imx-vpu-imx6q firmware-imx-vpu-imx6d"

# FIXME: Needs addition of firmware-imx of official BSPs
#MACHINE_FIRMWARE_append_mx27 = " firmware-imx-vpu-imx27"

MACHINE_EXTRA_RRECOMMENDS += "${MACHINE_FIRMWARE}"

# Extra audio support
MACHINE_EXTRA_RRECOMMENDS_append_mx6 = " ${@bb.utils.contains('DISTRO_FEATURES', 'alsa', 'imx-alsa-plugins', '', d)}"
MACHINE_EXTRA_RRECOMMENDS_append_mx7 = " ${@bb.utils.contains('DISTRO_FEATURES', 'alsa', 'imx-alsa-plugins', '', d)}"
MACHINE_EXTRA_RRECOMMENDS_append_mx8 = " ${@bb.utils.contains('DISTRO_FEATURES', 'alsa', 'imx-alsa-plugins', '', d)}"

# Extra udev rules
MACHINE_EXTRA_RRECOMMENDS += "udev-rules-imx"

# GStreamer 1.0 plugins
MACHINE_GSTREAMER_1_0_PLUGIN ?= ""
MACHINE_GSTREAMER_1_0_PLUGIN_mx6dl ?= "gstreamer1.0-plugins-imx-meta"
MACHINE_GSTREAMER_1_0_PLUGIN_mx6q ?= "gstreamer1.0-plugins-imx-meta"
MACHINE_GSTREAMER_1_0_PLUGIN_mx6sl ?= "gstreamer1.0-plugins-imx-meta"
MACHINE_GSTREAMER_1_0_PLUGIN_mx6sx ?= "gstreamer1.0-plugins-imx-meta"
MACHINE_GSTREAMER_1_0_PLUGIN_mx6ul ?= "gstreamer1.0-plugins-imx-meta"
MACHINE_GSTREAMER_1_0_PLUGIN_mx6ull ?= "gstreamer1.0-plugins-imx-meta"
MACHINE_GSTREAMER_1_0_PLUGIN_mx7d ?= "gstreamer1.0-plugins-imx-meta"

# Determines if the SoC has support for Vivante kernel driver
SOC_HAS_VIVANTE_KERNEL_DRIVER_SUPPORT        = "0"
SOC_HAS_VIVANTE_KERNEL_DRIVER_SUPPORT_imxgpu = "1"

# Handle Vivante kernel driver setting:
#   0 - machine does not have Vivante GPU driver support
#   1 - machine has Vivante GPU driver support
MACHINE_HAS_VIVANTE_KERNEL_DRIVER_SUPPORT ?= "${SOC_HAS_VIVANTE_KERNEL_DRIVER_SUPPORT}"

# Graphics libraries
PREFERRED_PROVIDER_virtual/egl      ?= "mesa"
PREFERRED_PROVIDER_virtual/libgl    ?= "mesa"
PREFERRED_PROVIDER_virtual/libgles1 ?= "mesa"
PREFERRED_PROVIDER_virtual/libgles2 ?= "mesa"

PREFERRED_PROVIDER_virtual/egl_imxgpu        ?= "imx-gpu-viv"
PREFERRED_PROVIDER_virtual/libgl_imxgpu3d    ?= "imx-gpu-viv"
PREFERRED_PROVIDER_virtual/libgles1_imxgpu3d ?= "imx-gpu-viv"
PREFERRED_PROVIDER_virtual/libgles2_imxgpu3d ?= "imx-gpu-viv"
PREFERRED_PROVIDER_virtual/libg2d            ?= "imx-gpu-g2d"

PREFERRED_VERSION_weston_mx6 ?= "4.0.0.imx"
PREFERRED_VERSION_weston_mx7 ?= "4.0.0.imx"
PREFERRED_VERSION_weston_mx8 ?= "4.0.0.imx"

PREFERRED_VERSION_wayland-protocols_mx6 ?= "1.13.imx"
PREFERRED_VERSION_wayland-protocols_mx7 ?= "1.13.imx"
PREFERRED_VERSION_wayland-protocols_mx8 ?= "1.13.imx"

# Use i.MX libdrm Version
PREFERRED_VERSION_libdrm_mx6 ?= "2.4.91.imx"
PREFERRED_VERSION_libdrm_mx7 ?= "2.4.91.imx"
PREFERRED_VERSION_libdrm_mx8 ?= "2.4.91.imx"

SERIAL_CONSOLE ?= "115200 ttymxc0"
SERIAL_CONSOLE_mxs ?= "115200 ttyAMA0"

KERNEL_IMAGETYPE ?= "zImage"
KERNEL_IMAGETYPE_aarch64 ?= "Image"

MACHINE_FEATURES ?= "usbgadget usbhost vfat alsa touchscreen"

# Add the ability to specify _imx machines
MACHINEOVERRIDES =. "imx:"

HOSTTOOLS_NONFATAL_append_mx8x = " sha384sum"
```

## conf/machine/include/tx-base.inc
```bitbake
# Set specific make target and binary suffix
PREFERRED_PROVIDER_u-boot ??= "u-boot-karo"
PREFERRED_PROVIDER_virtual/bootloader ??= "u-boot-karo"
include imx-base.inc

UBOOT_MAKE_TARGET ??= "u-boot.bin"
UBOOT_SUFFIX ??= "bin"

UBOOT_ENTRYPOINT_mx6  = "0x10008000"
UBOOT_ENTRYPOINT_mx6ul = "0x80008000"
# since the lines above break mainline for mx6 we add this default
# but it leaves us to set a correct entrypoint for txul machines
# using mainline bsp
UBOOT_ENTRYPOINT_use-mainline-bsp = "0x10008000"

# 'cortexa9-neon' 'cortexa9hf-neon'
DEFAULTTUNE_mx6 ?= "cortexa9hf-neon"
DEFAULTTUNE_mx6ul ?= "cortexa7hf-neon"

PREFERRED_PROVIDER_virtual/kernel ??= "linux-karo"
KERNEL_IMAGETYPE ?= "uImage"

MACHINE_FEATURES ?= " \
                 alsa \
                 rtc \
                 serial \
                 touchscreen \
                 usbgadget \
                 usbhost \
                 vfat \
"

# Add the ability to specify _imx machines
MACHINEOVERRIDES =. "imx:"


# Default baseboard name
TXBASE_DEFAULT_mx6 ?= "mb7"
TXBASE_DEFAULT_mx6ul ?= "evalkit"

TXBASE ?= "${TXBASE_DEFAULT}"
```

## conf/machine/include/tx8m-base.inc
```bitbake
MACHINEOVERRIDES =. "mx8:mx8m:tx8m:"

KBUILD_BUILD_USER := "support"
KBUILD_BUILD_HOST := "karo-electronics.de"

require conf/machine/include/imx-base.inc
require conf/machine/include/tune-cortexa53.inc

MACHINE_USES_VIVANTE_KERNEL_DRIVER_MODULE = "0"
MACHINE_HAS_VIVANTE_KERNEL_DRIVER_SUPPORT = "1"

XSERVER_DRIVER_use-mainline-bsp = "xf86-video-fbdev"
XSERVER ?= "xserver-xorg \
           xf86-input-evdev \
           ${XSERVER_DRIVER}"

UBOOT_CONFIG ??= "default"

SPL_BINARY = "spl/u-boot-spl.bin"

# Set DDR FIRMWARE
DDR_FIRMWARE_NAME = "ddr3_imem_1d.bin ddr3_dmem_1d.bin"

# Set imx-mkimage boot target
IMXBOOT_TARGETS = "flash_tx8m"

# Set Serial console
SERIAL_CONSOLE = "115200 ttymxc0"

IMAGE_BOOTLOADER = "imx-boot"

BOOT_SPACE = "65536"

LOADADDR = ""
UBOOT_SUFFIX = "bin"
UBOOT_MAKE_TARGET = ""
IMX_BOOT_SEEK = "33"

# Kernel Configs
PREFERRED_VERSION_linux-imx ?= "5.4"

# Remove some image types we don't need
IMAGE_FSTYPES_remove = "sdcard.bz2"

PREFERRED_PROVIDER_ptpd = "ptpd"

# Use correct VPU
PREFERRED_PROVIDER_virtual/imxvpu = "imx-vpu-hantro"

PREFERRED_PROVIDER_u-boot = "u-boot-imx"
PREFERRED_PROVIDER_u-boot-fw-utils = "u-boot-fw-utils-imx"
PREFERRED_PROVIDER_u-boot-tools = "u-boot-tools-imx"

PREFERRED_VERSION_u-boot-imx = "2018.03"
PREFERRED_VERSION_u-boot-fw-utils-imx = "2018.03"
PREFERRED_VERSION_u-boot-tools-imx = "2018.03"
```

## conf/machine/tx6q-8037-aclavis.conf
```bitbake
#@TYPE: Machine
#@NAME: Glyn Aclavis Board with TX6Q-8037
#@SOC: i.MX6QP
#@DESCRIPTION: Machine configuration for Glyn Aclavis with parallel RGB displays
#@MAINTAINER: Florian Boor <florian@kernelconcepts.de>

KERNEL_DEVICETREE = "imx6qp-tx6qp-8037-aclavis.dtb"

PREFERRED_PROVIDER_virtual/kernel ?= "linux-karo"

MACHINE_FEATURES_append = " wifi bluetooth touchscreen usbhost usbgadget screen alsa"

TXBASE = "aclavis"

require tx6q-8037.conf
```

## conf/machine/tx6q-8137-aclavis.conf
```bitbake
#@TYPE: Machine
#@NAME: Glyn Aclavis Board (10" lvds display) with TX6Q-8137
#@SOC: i.MX6QP
#@DESCRIPTION: Machine configuration for Glyn Aclavis with 10"LVDS Display
#@MAINTAINER: Ole Reinhardt <ole.reinhardt@kernelconcepts.de>

KERNEL_DEVICETREE = "imx6qp-tx6qp-8137-aclavis-lvds.dtb"

PREFERRED_PROVIDER_virtual/kernel ?= "linux-karo"

MACHINE_FEATURES_append = " wifi bluetooth touchscreen usbhost usbgadget screen alsa"

TXBASE = "aclavis"

require tx6q-8137.conf
```

## conf/machine/tx6s-8034.conf
```bitbake
#@TYPE: Machine
#@NAME: Ka-Ro electronics i.MX6S TX6S Computer-On-Module
#@SOC: i.MX6S
#@DESCRIPTION: Machine configuration for Ka-Ro electronics TX6S Computer-On-Module
#@MAINTAINER: Oliver Wendt <ow@karo-electronics.com>

KERNEL_DEVICETREE ?= "imx6dl-tx6s-8034{,-mb7}.dtb"

UBOOT_MACHINE ?= "tx6s-8034_config"

require imx6dl-tx6-nand.conf
```

## conf/machine/tx6u-8033-aclavis.conf
```bitbake
#@TYPE: Machine
#@NAME: Glyn Aclavis Board with TX6U-8033
#@SOC: i.MX6DL
#@DESCRIPTION: Machine configuration for Glyn Aclavis with parallel RGB displays
#@MAINTAINER: Florian Boor <florian@kernelconcepts.de>

KERNEL_DEVICETREE = "imx6dl-tx6u-8033-aclavis.dtb"

PREFERRED_PROVIDER_virtual/kernel ?= "linux-karo"

MACHINE_FEATURES_append = " wifi bluetooth touchscreen usbhost usbgadget screen alsa"

TXBASE = "aclavis"

require tx6u-8033.conf

UBOOT_ENTRYPOINT = "0x10008000"
```

## conf/machine/tx6u-8033.conf
```bitbake
#@TYPE: Machine
#@NAME: Ka-Ro electronics i.MX6DL TX6DL Computer-On-Module
#@SOC: i.MX6DL
#@DESCRIPTION: Machine configuration for Ka-Ro electronics TX6DL Computer-On-Module
#@MAINTAINER: Florian Boor <florian@kernelconcepts.de>


MACHINEOVERRIDES .= ":use-mainline-bsp"

KERNEL_DEVICETREE ?= "imx6dl-tx6u-8033.dtb imx6dl-tx6u-8033-mb7.dtb"

UBOOT_MACHINE ?= "tx6u-8033_config"

require imx6dl-tx6-emmc.conf
```

## conf/machine/tx6u-8133.conf
```bitbake
#@TYPE: Machine
#@NAME: Ka-Ro electronics i.MX6DL TX6DL Computer-On-Module
#@SOC: i.MX6DL
#@DESCRIPTION: Machine configuration for Ka-Ro electronics TX6DL Computer-On-Module
#@MAINTAINER: Oliver Wendt <ow@karo-electronics.com>


KERNEL_DEVICETREE ??= "imx6dl-tx6u-8133{,-mb7}.dtb"

UBOOT_MACHINE ?= "tx6u-8133_config"
TXBASE_append = "-lvds"

require imx6dl-tx6-emmc.conf
```

## conf/machine/tx8m-1610-mipi-mb.conf
```bitbake
#@TYPE: Machine
#@NAME: Ka-Ro electronics NXP i.MX8MM TX8M Computer-On-Module
#@SOC: i.MX8MM
#@DESCRIPTION: Machine configuration for Ka-Ro electronics TX8M Computer-On-Module on Mipi Mainboard
#@MAINTAINER: Florian Boor <florian@kernelconcepts.de>

require tx8m-1610.conf

KERNEL_DEVICETREE = "freescale/imx8mm-tx8m-1610-mipi-mb.dtb"
```

## conf/machine/tx8m-1610.conf
```bitbake
#@TYPE: Machine
#@NAME: Ka-Ro electronics NXP i.MX8MM TX8M Computer-On-Module
#@SOC: i.MX8MM
#@DESCRIPTION: Machine configuration for Ka-Ro electronics TX8M Computer-On-Module
#@MAINTAINER: Ka-Ro electronics GmbH <support@karo-electronics.com>
#@VERSION: 1
#@DATE: 2019-04-12

require include/tx8-base.inc

# Ka-Ro specific Device Tree files to be compiled
KERNEL_DEVICETREE ?= "freescale/imx8mm-tx8m-1610.dtb"

MACHINEOVERRIDES .= ":use-mainline-bsp"

PREFERRED_PROVIDER_virtual/kernel ?= "linux-imx"
PREFERRED_PROVIDER_virtual/bootloader ?= "u-boot-imx"
```

## conf/machine/txul-5010.conf
```bitbake
#@TYPE: Machine
#@NAME: Ka-Ro electronics TX6UL NAND
#@SOC: i.MX6UL
#@DESCRIPTION: Machine configuration for Ka-Ro electronics TX6UL (i.MX6UL) Computer-On-Module with NAND
#@MAINTAINER: Oliver Wendt <ow@karo-electronics.com>

KERNEL_DEVICETREE ??= "imx6ul-tx6ul-0010.dtb"

UBOOT_MACHINE ?= "tx6ul-0010_config"

require imx6ul-txul-nand.conf
```
